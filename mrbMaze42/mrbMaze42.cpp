#include <mrbMaze42.h>
#include <SPI.h>
#include <Wire.h>
#include <Adafruit_GFX.h>
#include <Adafruit_SSD1306.h>
#include <EEPROM.h>
#include <Servo.h>

Adafruit_SSD1306 display(128, 64, &Wire, 4);

#define ledSen  6
#define led     13
#define okSw    11
#define backSw  12
#define upSw    10
#define downSw  9
#define outSen  A0
#define s0Sen   15
#define s1Sen   16
#define s2Sen   17
#define battPin A7
#define lDir 	2
#define lPwm 	3
#define rDir 	4
#define rPwm 	5
#define liftPin	7
#define gripPin	8

int liftDown = 25;
int	liftUp = 65;
int	gripOpen = 40;
int	gripClose = 90;

Servo liftServo;
Servo gripServo;

int 	valSen[8];
bool 	valSenDigi[8];
int		memSen[8];
int		minSen[8];
double	calSen[8];
int		dataSen[8][40];
int 	nMode, error, errorMode, errorLast, pwmL, pwmR;
bool	lineCol;
float	valKp, valKi, valKd, pid;

int lift, grip, memLift, memGrip;

const unsigned char barV [] PROGMEM = { 0xFF };
const unsigned char myrobo [] PROGMEM = {
	// 'myrobo, 128x44px
	0x00, 0x00, 0x00, 0x00, 0x00, 0x00, 0x00, 0x00, 0x00, 0x00, 0x00, 0x00, 0x00, 0x00, 0x00, 0x00, 
	0x00, 0x00, 0x01, 0x80, 0x00, 0x00, 0x00, 0x00, 0x00, 0x00, 0x00, 0x00, 0x00, 0x00, 0x00, 0x00, 
	0x00, 0x00, 0x00, 0x80, 0x00, 0x00, 0x00, 0x00, 0x00, 0x00, 0x00, 0x00, 0x00, 0x00, 0x00, 0x00, 
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	0x00, 0x00, 0x00, 0x00, 0x00, 0x00, 0x00, 0x00, 0x00, 0x00, 0x00, 0x00, 0x00, 0x00, 0x00, 0x00
};

const unsigned char startMode [] PROGMEM = {
	// 'startMode, 100x58px
	0x00, 0x00, 0x00, 0x00, 0x00, 0x00, 0x00, 0x00, 0x00, 0x00, 0x00, 0x00, 0x00, 0x00, 0x00, 0x00, 
	0x00, 0x00, 0x00, 0x00, 0x00, 0x01, 0xe0, 0x00, 0x00, 0x00, 0x00, 0x00, 0x00, 0x00, 0x00, 0x00, 
	0x00, 0x00, 0xcf, 0xfc, 0xc0, 0x00, 0x00, 0x00, 0x00, 0x00, 0x00, 0x00, 0x00, 0x00, 0x01, 0xff, 
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	0x00, 0x00
};

const unsigned char speedTest [] PROGMEM = {
	// 'speedTest, 86x48px
	0x00, 0x00, 0x00, 0x00, 0x00, 0x00, 0x7f, 0x80, 0x00, 0x00, 0x00, 0x00, 0x00, 0x00, 0x00, 0x00, 
	0x7c, 0xff, 0xf8, 0x00, 0x00, 0x00, 0x00, 0x00, 0x00, 0x00, 0x07, 0xfc, 0xff, 0xf3, 0x80, 0x00, 
	0x00, 0x00, 0x00, 0x00, 0x00, 0x1f, 0xfc, 0xff, 0xe7, 0xe0, 0x00, 0x00, 0x00, 0x00, 0x00, 0x00, 
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	0x87, 0xe7, 0xc2, 0x00, 0x00, 0x00, 0x00, 0x00, 0x00, 0x00, 0x00, 0x00, 0x00, 0x00, 0x00, 0x00
};

const unsigned char sensorCalibrate [] PROGMEM = {
	// 'sensorCalibrate, 107x49px
	0x00, 0x00, 0x00, 0x00, 0x00, 0x00, 0x0c, 0x00, 0x00, 0x00, 0x00, 0x30, 0x00, 0x00, 0x00, 0x00, 
	0x00, 0x00, 0x00, 0x00, 0x18, 0x00, 0x03, 0xc0, 0x00, 0x18, 0x00, 0x00, 0x00, 0x00, 0x00, 0x00, 
	0x00, 0x00, 0x78, 0x00, 0x1f, 0xf8, 0x00, 0x1e, 0x00, 0x00, 0x00, 0x00, 0x00, 0x00, 0x00, 0x00, 
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	0x00, 0x00, 0x00, 0x00, 0x00, 0x00, 0x00, 0x70, 0x00, 0x00, 0x0e, 0x00, 0x00, 0x00
};

const unsigned char batt [] PROGMEM = {
	// 'batt, 15x8px
	0xff, 0xfc, 0x80, 0x04, 0x80, 0x06, 0x80, 0x06, 0x80, 0x06, 0x80, 0x06, 0x80, 0x04, 0xff, 0xfc
};

const unsigned char motorTest [] PROGMEM = {
	// 'motor, 64x25px
	0x00, 0x00, 0x3f, 0xfe, 0x03, 0xfc, 0x00, 0x00, 0x00, 0x00, 0x7f, 0xfe, 0x03, 0xfe, 0x00, 0x00, 
	0x00, 0x00, 0xff, 0xfe, 0x03, 0xff, 0x00, 0x00, 0x7f, 0xf1, 0xff, 0xfc, 0x07, 0xff, 0x8f, 0xfe, 
	0xff, 0xf9, 0xff, 0xfc, 0x07, 0xff, 0x9f, 0xff, 0xff, 0xf8, 0x00, 0x00, 0x00, 0x00, 0x1f, 0xff, 
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	0x00, 0x00, 0x03, 0x00, 0x01, 0xc0, 0x00, 0x00
};

const unsigned char forward [] PROGMEM = {
	// 'forward, 10x17px
	0xcc, 0xc0, 0xcc, 0xc0, 0xcc, 0xc0, 0xcc, 0xc0, 0xcc, 0xc0, 0xcc, 0x00, 0xcc, 0x00, 0xcc, 0xc0, 
	0xcc, 0xc0, 0x0c, 0x00, 0x0c, 0x00, 0xcc, 0x00, 0xcc, 0x00, 0x00, 0x00, 0x00, 0x00, 0x0c, 0x00, 
	0x0c, 0x00
};

const unsigned char backward [] PROGMEM = {
	// 'backward, 10x17px
	0x0c, 0x00, 0x0c, 0x00, 0x00, 0x00, 0x00, 0x00, 0xcc, 0x00, 0xcc, 0x00, 0x0c, 0x00, 0x0c, 0x00, 
	0xcc, 0xc0, 0xcc, 0xc0, 0xcc, 0x00, 0xcc, 0x00, 0xcc, 0xc0, 0xcc, 0xc0, 0xcc, 0xc0, 0xcc, 0xc0, 
	0xcc, 0xc0
};

const unsigned char gripper [] PROGMEM = {
	// 'gripper, 88x46px
	0x00, 0x00, 0x00, 0x00, 0x00, 0x00, 0x00, 0x00, 0x03, 0xf8, 0x00, 0x00, 0x00, 0x00, 0x00, 0x00, 
	0x00, 0x00, 0x00, 0x1f, 0xff, 0x00, 0x00, 0x00, 0x00, 0x00, 0x00, 0x00, 0x00, 0x00, 0x7f, 0xff, 
	0xc0, 0x00, 0x00, 0x00, 0x00, 0x00, 0x00, 0x00, 0x00, 0xff, 0xff, 0xe0, 0x00, 0x00, 0x00, 0x00, 
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	0x0f, 0x00, 0x00, 0x00, 0x0f, 0xc9, 0x92, 0x04, 0x0f, 0x26
};

mrbMaze42::mrbMaze42(){}

void(*my_reset)(void)=0;

void mrbMaze42::mazeSetup(){
	pinMode(ledSen,OUTPUT);
	pinMode(led,OUTPUT);
	pinMode(okSw,INPUT_PULLUP);
	pinMode(backSw,INPUT_PULLUP);
	pinMode(upSw,INPUT_PULLUP);
	pinMode(downSw,INPUT_PULLUP);
	pinMode(s0Sen,OUTPUT);
	pinMode(s1Sen,OUTPUT);
	pinMode(s2Sen,OUTPUT);
	pinMode(lDir,OUTPUT);
	pinMode(rDir,OUTPUT);
  
	display.begin(SSD1306_SWITCHCAPVCC, 0x3C);
	display.setTextColor(1, 1);
	display.clearDisplay();
	display.display();
	
	motorDrive(0,0);
	nMode = 0;
	
	/*
	for (int i=0; i<=7; i++) {
		memSen[i] = EEPROM.read(i);
		delay(20);
	}
	*/
	
	liftServo.attach(liftPin);
	gripServo.attach(gripPin);
	liftServo.write(liftUp);		// 22 = down, 75 = up
	gripServo.write(gripOpen);		// 45 = open, 90 = close
	memLift = liftUp;
	memGrip = gripOpen;
	
	/*delay(1000);
	for (int i=75; i>=22; i--) { liftServo.write(i); delay(1); }
	delay(400);
	for (int i=45; i<=90; i++) { gripServo.write(i); delay(3); }
	delay(400);
	for (int i=22; i<=75; i++) { liftServo.write(i); delay(1); }
	delay(5000);
	
	for (int i=75; i>=22; i--) { liftServo.write(i); delay(1); }
	delay(400);
	for (int i=90; i>=45; i--) { gripServo.write(i); delay(3); }
	delay(400);
	for (int i=22; i<=75; i++) { liftServo.write(i); delay(1); }
	delay(1000);*/
	
}

void mrbMaze42::welcomeScreen(){
	digitalWrite(led,HIGH);
	display.clearDisplay();
	display.drawBitmap(0, 10, myrobo, 128, 44, 1);
	display.display();
	display.drawPixel(127, 63, 1);
	for (int n=102; n<=127; n++) {
		display.drawPixel(n, 63, 1);
		display.display();
	}
	digitalWrite(led,LOW);
}

void mrbMaze42::start(){ 
	while(1) {
		if (digitalRead(upSw) == 0) { nMode--; delay(200); }
		if (digitalRead(downSw) == 0) { nMode++; delay(200); }
		if (digitalRead(okSw) == 0) { nMode+=10; delay(200); }
		
		if (nMode == 4) { nMode = 0; }
		else if (nMode == -1) { nMode = 3; }
		
		if (nMode == 0) {												// go menu
			display.clearDisplay();
			display.drawBitmap(25, 3, startMode, 100, 58, 1);
			for (int i=10; i<=63; i++) { display.drawPixel(1, i, 1); }
			for (int i=11; i<=23; i++) { display.drawPixel(0, i, 1); display.drawPixel(2, i, 1); }
			battTest();
			display.display();
		}
		else if (nMode == 1) {											// speed test menu
			display.clearDisplay();
			display.drawBitmap(40, 8, speedTest, 86, 48, 1);
			for (int i=10; i<=63; i++) { display.drawPixel(1, i, 1); }
			for (int i=24; i<=36; i++) { display.drawPixel(0, i, 1); display.drawPixel(2, i, 1); }
			battTest();
			display.display();
		}
		else if (nMode == 2) {											// calibrate menu
			display.clearDisplay();
			display.drawBitmap(21, 15, sensorCalibrate, 107, 49, 1);
			for (int i=10; i<=63; i++) { display.drawPixel(1, i, 1); }
			for (int i=37; i<=49; i++) { display.drawPixel(0, i, 1); display.drawPixel(2, i, 1); }
			battTest();
			display.display();
		}
		else if (nMode == 3) {											// speed test menu
			display.clearDisplay();
			display.drawBitmap(40, 12, gripper, 88, 46, 1);
			for (int i=10; i<=63; i++) { display.drawPixel(1, i, 1); }
			for (int i=50; i<=62; i++) { display.drawPixel(0, i, 1); display.drawPixel(2, i, 1); }
			battTest();
			display.display();
		}
		else if (nMode == 10) {											// start
			digitalWrite(led,HIGH);
			delay(500);
			display.clearDisplay();
			display.display();
			nMode = 0;
			digitalWrite(led,LOW);
			break;
		}
		else if (nMode == 11) {											// speed test
			int lSpeed = 0; int rSpeed = 0;
			nMode = 1;
			while (!digitalRead(backSw) == 0) {
				display.clearDisplay();
				display.drawBitmap(32, 19, motorTest, 64, 25, 1);
				display.setTextSize(1);
				display.setCursor(2,28);
				display.print(lSpeed);
				display.setCursor(103,28);
				display.print(rSpeed);
				if (digitalRead(okSw) == 0) { nMode = -nMode; delay(200); }
				if (nMode == 1) {
					for (int i=2; i<=20; i++) { display.drawPixel(i, 38, 1); }
					if (digitalRead(upSw) == 0) { lSpeed+=5; delay(70); }
					if (digitalRead(downSw) == 0) { lSpeed-=5; delay(70); }
					if (lSpeed > 250) { lSpeed = 250; }
					else if (lSpeed < -250) { lSpeed = -250; }
				}
				else if (nMode == -1) {
					for (int i=103; i<=121; i++) { display.drawPixel(i, 38, 1); }
					if (digitalRead(upSw) == 0) { rSpeed+=5; delay(70); }
					if (digitalRead(downSw) == 0) { rSpeed-=5; delay(70); }
					if (rSpeed > 250) { rSpeed = 250; }
					else if (rSpeed < -250) { rSpeed = -250; }
				}
				if (lSpeed > 0) { display.drawBitmap(33, 45, forward, 10, 17, 1); }
				else if (lSpeed < 0) { display.drawBitmap(33, 2, backward, 10, 17, 1); }
				if (rSpeed > 0) { display.drawBitmap(85, 45, forward, 10, 17, 1); }
				else if (rSpeed < 0) { display.drawBitmap(85, 2, backward, 10, 17, 1); }
				
				motorDrive(lSpeed,rSpeed);
				display.display();
			}
			delay(200); nMode = 1; motorDrive(0,0);
		}
		else if (nMode == 12) {											// calibrate
			nMode = 1;
			digitalWrite(ledSen,HIGH);
			while (!digitalRead(backSw) == 0) {
				display.clearDisplay();
				display.setTextSize(1);
				display.setCursor(22,4);
				display.print("DIGITAL SENSOR");
				display.setCursor(4,55);
				display.print("Push OK to Calibrate");
				for (int i=13; i<=115; i++) {
					display.drawPixel(i, 41, 1);
				}
				senTest();
				for (int i=0; i<=7; i++) {
					if (valSenDigi[i] == 1) {
						for (int n=26; n<=40; n++) {
							display.drawBitmap((i*12)+18, n, barV, 8, 1, 1);
						}
					}
					else {
						display.drawBitmap((i*12)+18, 40, barV, 8, 1, 1);
					}
				}
				
				if (digitalRead(okSw) == 0) { 
					display.clearDisplay();
					display.display();
					digitalWrite(led,HIGH);
					delay(500);
					
					for (int i=0; i<=7; i++) {
						calSen[i] = 0;
					}
					
					for (int h=0; h<=39; h++) {
						digitalWrite(led,HIGH);
						for (int i=0; i<=7; i++) {
							digitalWrite(s0Sen, HIGH && (i & B00000001));
							digitalWrite(s1Sen, HIGH && (i & B00000010));
							digitalWrite(s2Sen, HIGH && (i & B00000100));
							valSen[i] = analogRead(outSen);
							dataSen[i][h] = valSen[i];
							calSen[i] = calSen[i] + dataSen[i][h];
						}
						delay(50);
						digitalWrite(led,LOW);
						delay(50);
					}
	
					for (int l=0; l<=7; l++) {
						minSen[l] = calSen[l] / 40;
						memSen[l] = minSen[l] + 100;
					}
					
					while (1) {
						display.clearDisplay();
						display.setCursor(0,2);
						display.print("SENSOR SET OUTPUT");
						display.setCursor(0,16);
						display.print("1. ");
						display.print(memSen[0]);
						display.setCursor(0,28);
						display.print("2. ");
						display.print(memSen[1]);
						display.setCursor(0,40);
						display.print("3. ");
						display.print(memSen[2]);
						display.setCursor(0,52);
						display.print("4. ");
						display.print(memSen[3]);
						display.setCursor(51,16);
						display.print("5. ");
						display.print(memSen[4]);
						display.setCursor(51,28);
						display.print("6. ");
						display.print(memSen[5]);
						display.setCursor(51,40);
						display.print("7. ");
						display.print(memSen[6]);
						display.setCursor(51,52);
						display.print("8. ");
						display.print(memSen[7]);
						display.display();
					if (digitalRead(backSw) == 0 || digitalRead(okSw) == 0) { delay(250); break; }
					}
					
				}
				digitalWrite(led,LOW);
				display.display();
			}
			delay(200); nMode = 2;
			digitalWrite(ledSen,LOW);
		}
		else if (nMode == 13) {											// gripper setting
			int liftPow = 100; 
			int gripPow = 0;
			nMode = 1;
			while (!digitalRead(backSw) == 0) {
				lift = map(liftPow, 0, 100, liftDown, liftUp);
				grip = map(gripPow, 0, 100, gripOpen, gripClose);
				liftServo.write(lift);
				gripServo.write(grip);
				display.clearDisplay();
				display.setTextSize(1);
				display.setCursor(14,17);
				display.print("LIFT :");
				display.setCursor(14,47);
				display.print("GRIP :");
				display.setTextSize(2);
				display.setCursor(58,13);
				display.print(liftPow);
				display.setCursor(58,43);
				display.print(gripPow);
				if (digitalRead(okSw) == 0) { nMode = -nMode; delay(200); }
				if (nMode == 1) {
					for (int i=15; i<=27; i++) { display.drawPixel(6, i, 1); display.drawPixel(7, i, 1); }
					if (digitalRead(upSw) == 0) { liftPow+=5; delay(100); }
					if (digitalRead(downSw) == 0) { liftPow-=5; delay(100); }
					if (liftPow > 100) { liftPow = 100; }
					else if (liftPow < 0) { liftPow = 0; }
				}
				else if (nMode == -1) {
					for (int i=45; i<=57; i++) { display.drawPixel(6, i, 1); display.drawPixel(7, i, 1); }
					if (digitalRead(upSw) == 0) { gripPow+=5; delay(100); }
					if (digitalRead(downSw) == 0) { gripPow-=5; delay(100); }
					if (gripPow > 100) { gripPow = 100; }
					else if (gripPow < 0) { gripPow = 0; }
				}
				display.display();
			}
			delay(200); nMode = 3;
			liftPow = 100; gripPow = 0;
			lift = map(liftPow, 0, 100, liftDown, liftUp);
			grip = map(gripPow, 0, 100, gripOpen, gripClose);
			liftServo.write(lift);
			gripServo.write(grip);
		}
	}
	digitalWrite(ledSen,HIGH);
	delay(200);
}

void mrbMaze42::battTest() {
	display.drawBitmap(0, 0, batt, 15, 8, 1);
	int battPercen = map(analogRead(battPin), 200, 225, 0, 100);
	int battBar = map(battPercen, 0, 100, 1, 11);
	if (battBar > 11) {battBar = 11;}
	if (battPercen > 100) { battPercen = 100; }
	else if (battPercen < 0) { battPercen = 0; }
	for (int i=2; i<=5; i++) {
		for (int j=2; j<=battBar; j++) { display.drawPixel(j, i, 1); }
	}
	display.setTextSize(1);
	display.setCursor(18,0);
	display.print(battPercen);
	display.print("%");
}

void mrbMaze42::sensorSet(int senVal1, int senVal2, int senVal3, int senVal4, int senVal5, int senVal6, int senVal7, int senVal8) {
	memSen[0] = senVal1; memSen[1] = senVal2; memSen[2] = senVal3; memSen[3] = senVal4;
	memSen[4] = senVal5; memSen[5] = senVal6; memSen[6] = senVal7; memSen[7] = senVal8;
}

void mrbMaze42::senTest() {
	for (int i=0; i<=7; i++) {
		digitalWrite(s0Sen, HIGH && (i & B00000001));
		digitalWrite(s1Sen, HIGH && (i & B00000010));
		digitalWrite(s2Sen, HIGH && (i & B00000100));
		valSen[i] = analogRead(outSen);
		if (valSen[i] > memSen[i]) { valSenDigi[i] = 0; }
		else { valSenDigi[i] = 1; }
	}
}

void mrbMaze42::motorDrive(int lSpeed, int rSpeed) {
	if (lSpeed >= 0) { 
		digitalWrite(lDir,HIGH); 
		analogWrite(lPwm,(lSpeed + 255) - (lSpeed * 2)); }
	else { 
		digitalWrite(lDir,LOW); 
		analogWrite(lPwm,(-lSpeed + 255) - (-lSpeed * 2)); }
	if (rSpeed >= 0) { 
		digitalWrite(rDir,LOW); 
		analogWrite(rPwm,(rSpeed + 255) - (rSpeed * 2)); }
	else { 
		digitalWrite(rDir,HIGH); 
		analogWrite(rPwm,(-rSpeed + 255) - (-rSpeed * 2)); }
}

void mrbMaze42::motor(int lSpeed, int rSpeed, int dly) {
	digitalWrite(led,HIGH);
	motorDrive(lSpeed, rSpeed);
	delay(dly);
	motorDrive(0,0);
	digitalWrite(led,LOW);
}

void mrbMaze42::lineColour(int col) { lineCol = col; }

void mrbMaze42::pidSet(int kp, int ki, int kd) {
	valKp = kp;
	valKi = ki;
	valKd = kd;
}

void mrbMaze42::lineTrace(float power) {
	senTest();
	if (valSenDigi[0] == !lineCol && 
		valSenDigi[1] == !lineCol && 
		valSenDigi[2] == !lineCol && 
		valSenDigi[3] == lineCol && 
		valSenDigi[4] == lineCol && 
		valSenDigi[5] == !lineCol && 
		valSenDigi[6] == !lineCol && 
		valSenDigi[7] == !lineCol) { error = 0; errorMode = 0; }
		
	else if (valSenDigi[0] == !lineCol && 
			valSenDigi[1] == !lineCol && 
			valSenDigi[2] == !lineCol && 
			valSenDigi[3] == lineCol && 
			valSenDigi[4] == !lineCol && 
			valSenDigi[5] == !lineCol && 
			valSenDigi[6] == !lineCol && 
			valSenDigi[7] == !lineCol) { error = 1; errorMode = 1; }
			
	else if (valSenDigi[0] == !lineCol && 
			valSenDigi[1] == !lineCol && 
			valSenDigi[2] == !lineCol && 
			valSenDigi[3] == !lineCol && 
			valSenDigi[4] == lineCol && 
			valSenDigi[5] == !lineCol && 
			valSenDigi[6] == !lineCol && 
			valSenDigi[7] == !lineCol) { error = -1; errorMode = -1; }
			
	else if (valSenDigi[0] == !lineCol && 
			valSenDigi[1] == !lineCol && 
			valSenDigi[2] == lineCol && 
			valSenDigi[3] == lineCol && 
			valSenDigi[4] == !lineCol && 
			valSenDigi[5] == !lineCol && 
			valSenDigi[6] == !lineCol && 
			valSenDigi[7] == !lineCol) { error = 2; errorMode = 2; }
			
	else if (valSenDigi[0] == !lineCol && 
			valSenDigi[1] == !lineCol && 
			valSenDigi[2] == !lineCol && 
			valSenDigi[3] == !lineCol && 
			valSenDigi[4] == lineCol && 
			valSenDigi[5] == lineCol && 
			valSenDigi[6] == !lineCol && 
			valSenDigi[7] == !lineCol) { error = -2; errorMode = -2; }
			
	else if (valSenDigi[0] == !lineCol && 
			valSenDigi[1] == !lineCol && 
			valSenDigi[2] == lineCol && 
			valSenDigi[3] == !lineCol && 
			valSenDigi[4] == !lineCol && 
			valSenDigi[5] == !lineCol && 
			valSenDigi[6] == !lineCol && 
			valSenDigi[7] == !lineCol) { error = 3; errorMode = 3; }
			
	else if (valSenDigi[0] == !lineCol && 
			valSenDigi[1] == !lineCol && 
			valSenDigi[2] == !lineCol && 
			valSenDigi[3] == !lineCol && 
			valSenDigi[4] == !lineCol && 
			valSenDigi[5] == lineCol && 
			valSenDigi[6] == !lineCol && 
			valSenDigi[7] == !lineCol) { error = -3; errorMode = -3; }
			
	else if (valSenDigi[0] == !lineCol && 
			valSenDigi[1] == lineCol && 
			valSenDigi[2] == lineCol && 
			valSenDigi[3] == !lineCol && 
			valSenDigi[4] == !lineCol && 
			valSenDigi[5] == !lineCol && 
			valSenDigi[6] == !lineCol && 
			valSenDigi[7] == !lineCol) { error = 4; errorMode = 4; }
			
	else if (valSenDigi[0] == !lineCol && 
			valSenDigi[1] == !lineCol && 
			valSenDigi[2] == !lineCol && 
			valSenDigi[3] == !lineCol && 
			valSenDigi[4] == !lineCol && 
			valSenDigi[5] == lineCol && 
			valSenDigi[6] == lineCol && 
			valSenDigi[7] == !lineCol) { error = -4; errorMode = -4; }
			
	else if (valSenDigi[0] == !lineCol && 
			valSenDigi[1] == lineCol && 
			valSenDigi[2] == !lineCol && 
			valSenDigi[3] == !lineCol && 
			valSenDigi[4] == !lineCol && 
			valSenDigi[5] == !lineCol && 
			valSenDigi[6] == !lineCol && 
			valSenDigi[7] == !lineCol) { error = 5; errorMode = 5; }
			
	else if (valSenDigi[0] == !lineCol && 
			valSenDigi[1] == !lineCol && 
			valSenDigi[2] == !lineCol && 
			valSenDigi[3] == !lineCol && 
			valSenDigi[4] == !lineCol && 
			valSenDigi[5] == !lineCol && 
			valSenDigi[6] == lineCol && 
			valSenDigi[7] == !lineCol) { error = -5; errorMode = -5; }
			
	else if (valSenDigi[0] == lineCol && 
			valSenDigi[1] == lineCol && 
			valSenDigi[2] == !lineCol && 
			valSenDigi[3] == !lineCol && 
			valSenDigi[4] == !lineCol && 
			valSenDigi[5] == !lineCol && 
			valSenDigi[6] == !lineCol && 
			valSenDigi[7] == !lineCol) { error = 6; errorMode = 6; }
			
	else if (valSenDigi[0] == !lineCol && 
			valSenDigi[1] == !lineCol && 
			valSenDigi[2] == !lineCol && 
			valSenDigi[3] == !lineCol && 
			valSenDigi[4] == !lineCol && 
			valSenDigi[5] == !lineCol && 
			valSenDigi[6] == lineCol && 
			valSenDigi[7] == lineCol) { error = -6; errorMode = -6; }
			
	else if (valSenDigi[0] == lineCol && 
			valSenDigi[1] == !lineCol && 
			valSenDigi[2] == !lineCol && 
			valSenDigi[3] == !lineCol && 
			valSenDigi[4] == !lineCol && 
			valSenDigi[5] == !lineCol && 
			valSenDigi[6] == !lineCol && 
			valSenDigi[7] == !lineCol) { error = 7; errorMode = 7; }
			
	else if (valSenDigi[0] == !lineCol && 
			valSenDigi[1] == !lineCol && 
			valSenDigi[2] == !lineCol && 
			valSenDigi[3] == !lineCol && 
			valSenDigi[4] == !lineCol && 
			valSenDigi[5] == !lineCol && 
			valSenDigi[6] == !lineCol && 
			valSenDigi[7] == lineCol) { error = -7; errorMode = -7; }
			
	else if (valSenDigi[0] == !lineCol && 
			valSenDigi[1] == !lineCol && 
			valSenDigi[2] == !lineCol && 
			valSenDigi[3] == !lineCol && 
			valSenDigi[4] == !lineCol && 
			valSenDigi[5] == !lineCol && 
			valSenDigi[6] == !lineCol && 
			valSenDigi[7] == !lineCol) {
			if (errorMode == 0) { error = 0; }
			else if (errorMode == 1) { error = 1; }
			else if (errorMode == -1) { error = -1; }
			else if (errorMode == 2) { error = 2; }
			else if (errorMode == -2) { error = -2; }
			else if (errorMode == 3) { error = 3; }
			else if (errorMode == -3) { error = -3; }
			else if (errorMode == 4) { error = 4; }
			else if (errorMode == -4) { error = -4; }
			else if (errorMode == 5) { error = 5; }
			else if (errorMode == -5) { error = -5; }
			else if (errorMode == 6) { error = 6; }
			else if (errorMode == -6) { error = -6; }
			else if (errorMode == 7) { error = 7; }
			else if (errorMode == -7) { error = -7; }
	}
	
	pid = ((valKp*(power/250))*error) + ((valKi*(power/250))*(error+errorLast)) + ((valKd*(power/250))*(error-errorLast));
	pwmL = power - pid;
	pwmR = power + pid;
	if (pwmL>power) { pwmL = power; }
	if (pwmR>power) { pwmR = power; }
	motorDrive(pwmL,pwmR);
	errorLast = error;	
	delay(1);
}

void mrbMaze42::lineTraceSmooth(float power) {
	if (nMode == 0) {
		for (int i=40; i<=power; i++) {
			lineTrace(i);
		}
		nMode = 1;
	}
	else { lineTrace(power); }
}

void mrbMaze42::tright(int power) {
	while(1) {
		senTest();
		motorDrive(power,-power);
		if (valSenDigi[5] == !lineCol) { break; }
	}
	digitalWrite(led,HIGH);
	while(1) {
		senTest();
		motorDrive(power,-power);
		if (valSenDigi[5] == lineCol) { break; }
	}
	motorDrive(0,0);
	digitalWrite(led,LOW);
}

void mrbMaze42::tleft(int power) {
	while(1) {
		senTest();
		motorDrive(-power,power);
		if (valSenDigi[2] == !lineCol) { break; }
	}
	digitalWrite(led,HIGH);
	while(1) {
		senTest();
		motorDrive(-power,power);
		if (valSenDigi[2] == lineCol) { break; }	}
	motorDrive(0,0);
	digitalWrite(led,LOW);
}

void mrbMaze42::ld(int power, int dly) {
	digitalWrite(led,HIGH);
	for (int i=0; i<=dly/2; i++) {
		lineTraceSmooth(power);
	}
	motorDrive(0,0);
	digitalWrite(led,LOW);
}

void mrbMaze42::trigger(int power, int sensor, int step) {
	int a = sensor / 10;
	int b = sensor - (a * 10);
	while(1) {
		lineTraceSmooth(power);
		if (valSenDigi[a-1] == lineCol && valSenDigi[b-1] == lineCol) { break; }
	}
	motor(power,power,step);
}

void mrbMaze42::rl(int power, int step) {
	while(1) {
		lineTraceSmooth(power);
		if (valSenDigi[3] == lineCol || valSenDigi[4] == lineCol && valSenDigi[6] == lineCol) { motor(power,power,step); break; }
	}
	tright(power);
}

void mrbMaze42::ll(int power, int step) {
	while(1) {
		lineTraceSmooth(power);
		if (valSenDigi[3] == lineCol || valSenDigi[4] == lineCol && valSenDigi[1] == lineCol) { motor(power,power,step); break; }
	}
	tleft(power);
}

void mrbMaze42::prl(int power, int step) {
	while(1) {
		lineTraceSmooth(power);
		if ((valSenDigi[3] == lineCol || valSenDigi[4] == lineCol) && valSenDigi[6] == lineCol) { motor(power,power,step); break; }
	}
}

void mrbMaze42::pll(int power, int step) {
	while(1) {
		lineTraceSmooth(power);
		if ((valSenDigi[3] == lineCol || valSenDigi[4] == lineCol) && valSenDigi[1] == lineCol) { motor(power,power,step); break; }
	}
}

void mrbMaze42::rls(int power, int sensor, int step) {
	trigger(power, sensor, step);
	tright(power);
}

void mrbMaze42::lls(int power, int sensor, int step) {
	trigger(power, sensor, step);
	tleft(power);
}

void mrbMaze42::rld(int power, int sensor, int step, int dly) {
	trigger(power, sensor, step);
	motor(power, -power, dly);
}

void mrbMaze42::lld(int power, int sensor, int step, int dly) {
	trigger(power, sensor, step);
	motor(-power, power, dly);
}

void mrbMaze42::sac(int power) {
	while(1) {
		lineTraceSmooth(power);
		if (valSenDigi[0] == !lineCol &&
			valSenDigi[1] == !lineCol &&
			valSenDigi[2] == !lineCol &&
			valSenDigi[3] == !lineCol &&
			valSenDigi[4] == !lineCol &&
			valSenDigi[5] == !lineCol &&
			valSenDigi[6] == !lineCol &&
			valSenDigi[7] == !lineCol) 
			{ break; }
	}
	motorDrive(0,0);
}

void mrbMaze42::blink() {
	digitalWrite(led,HIGH);
	delay(10);
	digitalWrite(led,LOW);
}

void mrbMaze42::pickup(int gripPower, int liftHigh, int speed, int dly) {
	for (int i=memLift; i>=liftDown; i--) { 
		liftServo.write(i); 
		delay(speed); 
	}
	delay(dly);
	
	if (gripPower > 100) { gripPower = 100; }
	else if (gripPower < 0) { gripPower = 0; }
	grip = map(gripPower, 0, 100, gripOpen, gripClose);
	
	if (gripPower > memGrip) {
		for (int i=memGrip; i<=grip; i++) { 
			gripServo.write(i); 
			delay(speed);
		}			
	}
	else {
		for (int i=memGrip; i>=grip; i--) { 
			gripServo.write(i); 
			delay(speed);
		}			
	}
	delay(dly);
	
	if (liftHigh > 100) { liftHigh = 100; }
	else if (liftHigh < 0) { liftHigh = 0; }
	lift = map(liftHigh, 0, 100, liftDown, liftUp);
	
	for (int i=liftDown; i<=lift; i++) { 
		liftServo.write(i); 
		delay(speed); 
	}
	memLift = lift;
	memGrip = grip;
	delay(dly);
}

void mrbMaze42::putdown(int speed, int dly) {
	for (int i=memLift; i>=liftDown; i--) { 
		liftServo.write(i); 
		delay(speed); 
	}
	delay(dly);
	
	for (int i=memGrip; i>=gripOpen; i--) { 
		gripServo.write(i); 
		delay(speed);
	}
	delay(dly);
	
	for (int i=liftDown; i<=liftUp; i++) { 
		liftServo.write(i); 
		delay(speed); 
	}
	delay(dly);
	
}
	
void mrbMaze42::end(){
	digitalWrite(ledSen,LOW);
	digitalWrite(led,HIGH);
	delay(500);
	digitalWrite(led,LOW);
	my_reset();
}